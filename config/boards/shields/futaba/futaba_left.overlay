#include "futaba.dtsi"

&kscan0 {
    col-gpios
        = <&xiao_d 10 GPIO_ACTIVE_HIGH>
        , <&xiao_d 9 GPIO_ACTIVE_HIGH>
        , <&xiao_d 8 GPIO_ACTIVE_HIGH>
        , <&xiao_d 7 GPIO_ACTIVE_HIGH>
        , <&gpio0 10 GPIO_ACTIVE_HIGH>
        , <&gpio0 9 GPIO_ACTIVE_HIGH>
        ;
};

&trackball_listener {
    status = "okay";
    input-processors = <&zip_xy_scaler 3 2>, <&zip_temp_layer 11 2000>; 

    scroller { 
       layers = <10>;
       input-processors = <&zip_xy_to_scroll_mapper>;
    }; 
    snipe { 
       layers = <12>; 
       input-processors = <&zip_xy_scaler 1 4>;
    };
};

