## Kconfig
```kconfig
menuconfig PMW3610
    bool "Enable PMW3610 optical sensor"
    help
      Enable support for the PMW3610 optical trackball sensor.

if PMW3610

config PMW3610_SMART_ALGORITHM
    bool "Enable smart algorithm mode"
    default n

config PMW3610_CPI
    int "CPI (counts per inch)"
    default 400
    range 100 1600

config PMW3610_CPI_DIVIDOR
    int "CPI divisor"
    default 1
    range 1 4

config PMW3610_SNIPE_CPI
    int "CPI value in snipe mode"
    default 200

config PMW3610_SNIPE_CPI_DIVIDOR
    int "Divisor in snipe mode"
    default 2

config PMW3610_SCROLL_TICK
    int "Scroll tick interval"
    default 20

config PMW3610_POLLING_RATE_125_SW
    bool "Enable 125Hz polling"
    default y

config PMW3610_INVERT_SCROLL_X
    bool "Invert scroll direction X"
    default n

config PMW3610_INVERT_SCROLL_Y
    bool "Invert scroll direction Y"
    default n

config PMW3610_AUTOMOUSE_TIMEOUT_MS
    int "Timeout for auto mouse (ms)"
    default 400

endif
```

## config/west.yml
```yaml
manifest:
  remotes:
    - name: zmkfirmware
      url-base: https://github.com/zmkfirmware
    - name: enoken0222
      url-base: https://github.com/enoken0222
  projects:
    - name: zmk
      remote: zmkfirmware
      revision: main
      import: app/west.yml
    - name: zmk-pmw3610-driver
      remote: enoken0222
      revision: main
  self:
    path: config
```
